## config/west.yml
```yaml
manifest:
  remotes:
    - name: zmkfirmware
      url-base: https://github.com/zmkfirmware
    - name: petejohanson
      url-base: https://github.com/petejohanson
    - name: zzuse
      url-base: https://github.com/zzuse
  projects:
    - name: zmk
      remote: zmkfirmware
      revision: main
      import: app/west.yml
    - name: zmk-nice-oled-zz
      remote: zzuse
      revision: migrate-lvgl9-vertical
  self:
    path: config
```
